
  /*
  * Copyright (c) 2020 The ZMK Contributors
  *
  * SPDX-License-Identifier: MIT
  */

  #include <behaviors.dtsi>
  #include <dt-bindings/zmk/keys.h>
  #include <dt-bindings/zmk/bt.h>
  #include <dt-bindings/zmk/ext_power.h>

  / {
    keymap {
      compatible = "zmk,keymap";
  layer0 {
          bindings = <
          &kp LOCKING_NUM &kp KP_SLASH &kp KP_ASTERISK &kp KP_MINUS &kp KP_N7 &kp KP_N8 &kp KP_N9 &kp KP_N4 &kp KP_N5 &kp KP_N6 &kp KP_PLUS &kp KP_N1 &kp KP_N2 &kp KP_N3 &kp KP_N0 &kp KP_DOT &kp KP_ENTER
          >;
        };layer1 {
          bindings = <
          &kp LOCKING_NUM &kp KP_SLASH &kp KP_ASTERISK &kp KP_MINUS &kp HOME &kp UP &kp PAGE_UP &kp LEFT &kp LOCKING_NUM &kp RIGHT &kp KP_PLUS &kp END &kp DOWN &kp PAGE_DOWN &kp INSERT &kp DELETE &kp KP_ENTER
          >;
        };
    };
  };
  
